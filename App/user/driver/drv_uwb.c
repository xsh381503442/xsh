/**
*Module:UWB
*Chip:
*Version: V 0.0.1
*Time: 2018/03/14
**/
#include <stdio.h>
#include "drv_heartrate.h"
#include "bsp_uart.h"
#include "drv_config.h"
#include "bsp.h"
#include "bsp_iom.h"
#include "isr_gpio.h"
#include "task_uart.h"
#include "bsp_timer.h"
#include "drv_tca6408a.h"
#include "drv_uwb.h"


#if DEBUG_ENABLED == 1 && DRV_HEARTRATE_LOG_ENABLED == 1
	#define DRV_HEARTRATE_LOG_WRITESTRING(...)			SEGGER_RTT_WriteString(0,__VA_ARGS__)
	#define DRV_HEARTRATE_LOG_PRINTF(...) 				SEGGER_RTT_printf(0,##__VA_ARGS__)
#else       
	#define DRV_HEARTRATE_LOG_WRITESTRING(...)
	#define DRV_HEARTRATE_LOG_PRINTF(...)		        
#endif



uint8_t g_UWB_Tx_Buffer[UWB_BUFFER_SIZE];
uint8_t g_UWB_Rx_Buffer[UWB_BUFFER_SIZE];

uint8_t		sendbuff[UWB_BUFFER_SIZE];

static am_hal_uart_config_t g_UWB_UartConfig =
{
	.ui32BaudRate = 115200,
	.ui32DataBits = AM_HAL_UART_DATA_BITS_8,
	.bTwoStopBits = false,
	.ui32Parity   = AM_HAL_UART_PARITY_NONE,
	.ui32FlowCtrl = AM_HAL_UART_FLOW_CTRL_NONE,
};

static const uint8_t aucCRCHi[] = {
        0x00, 0xC1, 0x81, 0x40, 0x01, 0xC0, 0x80, 0x41, 0x01, 0xC0, 0x80, 0x41,
        0x00, 0xC1, 0x81, 0x40, 0x01, 0xC0, 0x80, 0x41, 0x00, 0xC1, 0x81, 0x40,
        0x00, 0xC1, 0x81, 0x40, 0x01, 0xC0, 0x80, 0x41, 0x01, 0xC0, 0x80, 0x41,
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        0x00, 0xC1, 0x81, 0x40
};
static const uint8_t aucCRCLo[] = {
        0x00, 0xC0, 0xC1, 0x01, 0xC3, 0x03, 0x02, 0xC2, 0xC6, 0x06, 0x07, 0xC7,
        0x05, 0xC5, 0xC4, 0x04, 0xCC, 0x0C, 0x0D, 0xCD, 0x0F, 0xCF, 0xCE, 0x0E,
        0x0A, 0xCA, 0xCB, 0x0B, 0xC9, 0x09, 0x08, 0xC8, 0xD8, 0x18, 0x19, 0xD9,
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        0x41, 0x81, 0x80, 0x40
};


uint16_t  Get_Crc16(uint8_t *pucFrame,uint8_t usLen)
{
    uint8_t ucCRCHi = 0xFF;
    uint8_t ucCRCLo = 0xFF;
    int iIndex;
    while( usLen-- )
    {
        iIndex = ucCRCLo ^ *( pucFrame++ );
        ucCRCLo = (uint8_t)( ucCRCHi ^ aucCRCHi[iIndex] );
        ucCRCHi = aucCRCLo[iIndex];
    }
    return (uint16_t)( ucCRCHi << 8 | ucCRCLo );
}

/*
*函数: 设置标签发送信号周期
*输入: ·period   周期,单位0.1s，整数  例：1表示间隔0.1s发送，10表示间隔1s发送
		
*返回值:无
*备注 
*/
void SetPeriod( uint8_t period )
{
	uint16_t	crc = 0;
	uint8_t		i;
	
	am_hal_gpio_out_bit_set( BSP_GPIO_UWB_WAKEUP );
//	bsp_uart_init(0,g_UWB_UartConfig,g_UWB_Rx_Buffer,g_UWB_Tx_Buffer,UWB_BUFFER_SIZE);
	
	while(am_hal_gpio_input_bit_read(BSP_GPIO_UWB_BUSY) != 0);
	
	sendbuff[0] = 0x59;    	//SOF
	sendbuff[1] = 7;			//length
	sendbuff[2] = 0x81;		//command
	sendbuff[3] = period;	//period
	crc = Get_Crc16( sendbuff,4 );
	sendbuff[4] = (uint8_t)(crc & 0x00FF);
	sendbuff[5] = (uint8_t)(crc >> 8 );
	sendbuff[6] = 0x47;		//EOF
	
	for(i = 0;i < 7;i++)
	{
		am_hal_uart_char_transmit_buffered(0, sendbuff[i]);	
		
		while ( am_hal_uart_flags_get(0) & (AM_HAL_UART_FR_BUSY | AM_HAL_UART_FR_TX_FULL));
	}
}

/*
*函数: 设置标签发送开始定位命令
*输入: ·无
		
*返回值:无
*备注 
*/
void StartLocating( void )
{
	uint16_t	crc = 0;
	uint8_t		i;
	
	am_hal_gpio_out_bit_set( BSP_GPIO_UWB_WAKEUP );
	
//	bsp_uart_init(0,g_UWB_UartConfig,g_UWB_Rx_Buffer,g_UWB_Tx_Buffer,UWB_BUFFER_SIZE);
	while(am_hal_gpio_input_bit_read(BSP_GPIO_UWB_BUSY) != 0);
	
	sendbuff[0] = 0x59;    	//SOF
	sendbuff[1] = 7;			//length
	sendbuff[2] = 0x82;		//command
	sendbuff[3] = 0x01;	//period
	crc = Get_Crc16( sendbuff,4 );
	sendbuff[4] = (uint8_t)(crc & 0x00FF);
	sendbuff[5] = (uint8_t)(crc >> 8 );
//    sendbuff[4] = 0x02;	
//    sendbuff[5] = 0x03;	
	sendbuff[6] = 0x47;		//EOF
	
	for(i = 0;i < 7;i++)
	{
		am_hal_uart_char_transmit_buffered(0, sendbuff[i]);	
		
		while ( am_hal_uart_flags_get(0) & (AM_HAL_UART_FR_BUSY | AM_HAL_UART_FR_TX_FULL));
	}
}

/*
*函数: 开始OTA升级
*输入: ·无
		
*返回值:无
*备注 
*/
void StartBoot( void )
{
	uint16_t	crc = 0;
	uint8_t		i;
	
	am_hal_gpio_out_bit_set( BSP_GPIO_UWB_WAKEUP );
	
//	bsp_uart_init(0,g_UWB_UartConfig,g_UWB_Rx_Buffer,g_UWB_Tx_Buffer,UWB_BUFFER_SIZE);
	while(am_hal_gpio_input_bit_read(BSP_GPIO_UWB_BUSY) != 0);
	
	sendbuff[0] = 0x59;    	//SOF
	sendbuff[1] = 8;			//length
	sendbuff[2] = 0x90;		//command
	sendbuff[3] = 0xaa;	//period
    sendbuff[4] = 0xbb;	//period
	crc = Get_Crc16( sendbuff,5 );
	sendbuff[5] = (uint8_t)(crc & 0x00FF);
	sendbuff[6] = (uint8_t)(crc >> 8 );

	sendbuff[7] = 0x47;		//EOF
	
	for(i = 0;i < 8;i++)
	{
		am_hal_uart_char_transmit_buffered(0, sendbuff[i]);	
		
		while ( am_hal_uart_flags_get(0) & (AM_HAL_UART_FR_BUSY | AM_HAL_UART_FR_TX_FULL));
	}
}

/*
*函数: 发送数据
*输入: ·CO_Data   	CO浓度数据,单位 ppm，整数  
		heartrate	心率值
*返回值:无
*备注 
*/
void SendData( uint16_t CO_Data, uint8_t  heartrate )
{
	uint16_t	crc = 0;
	uint8_t		i;
	
	am_hal_gpio_out_bit_set( BSP_GPIO_UWB_WAKEUP );
//	bsp_uart_init(0,g_UWB_UartConfig,g_UWB_Rx_Buffer,g_UWB_Tx_Buffer,UWB_BUFFER_SIZE);
	
	sendbuff[0] = 0x59;    	//SOF
	sendbuff[1] = 10;			//length
	sendbuff[2] = 0x80;		//command
	sendbuff[3] = (uint8_t)(CO_Data & 0x00FF);	//
	sendbuff[4] = (uint8_t)(CO_Data >> 8 );
	sendbuff[5] = (uint8_t)(heartrate & 0x00FF);
	sendbuff[6] = (uint8_t)(heartrate >> 8 );
	crc = Get_Crc16( sendbuff,7 );
	sendbuff[7] = (uint8_t)(crc & 0x00FF);
	sendbuff[8] = (uint8_t)(crc >> 8 );
	sendbuff[9] = 0x47;		//EOF
	
	for(i = 0;i < 10;i++)
	{
		am_hal_uart_char_transmit_buffered(0, sendbuff[i]);	
		while ( am_hal_uart_flags_get(0) & (AM_HAL_UART_FR_BUSY | AM_HAL_UART_FR_TX_FULL));
	}
}


/*uwb初始化 --对串口，硬件使能脚，输出脚配置*/
void drv_uwb_init(void)
{
	DRV_HEARTRATE_LOG_PRINTF("[drv_uwb]:drv_uwb_init!\n");
    
    tca6408a_gpio_out_bit_set(BSP_GPIO_UWB_POWER);    
  
	
    am_hal_gpio_pin_config(BSP_GPIO_UWB_WAKEUP,AM_HAL_GPIO_OUTPUT | AM_HAL_GPIO_PULLUP );
	am_hal_gpio_out_bit_set( BSP_GPIO_UWB_WAKEUP );
    
    am_hal_gpio_pin_config(BSP_GPIO_UWB_BUSY,AM_HAL_GPIO_INPUT  );

    
    am_hal_gpio_pin_config(BSP_GPIO_UWB_SOS,AM_HAL_GPIO_OUTPUT | AM_HAL_GPIO_PULLUP );
	am_hal_gpio_out_bit_set( BSP_GPIO_UWB_SOS );
    
    bsp_uart_init(0,g_UWB_UartConfig,g_UWB_Rx_Buffer,g_UWB_Tx_Buffer,UWB_BUFFER_SIZE);
    


}
void drv_uwb_uninit(void)
{
    bsp_uart_disable(0);
	am_hal_gpio_pin_config(BSP_GPIO_UWB_WAKEUP,AM_HAL_PIN_DISABLE);
	am_hal_gpio_pin_config( BSP_GPIO_UWB_SOS, AM_HAL_PIN_DISABLE);
    am_hal_gpio_pin_config(BSP_GPIO_UWB_BUSY,AM_HAL_PIN_DISABLE);

	tca6408a_gpio_out_bit_clear( BSP_GPIO_UWB_POWER );
		
	DRV_HEARTRATE_LOG_PRINTF("[drv_uwb]:drv_uwb_uninit!\n");
}





